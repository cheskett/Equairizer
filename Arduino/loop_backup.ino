/**
 * LED Matrix library for http://www.seeedstudio.com/depot/ultrathin-16x32-red-led-matrix-panel-p-1582.html
 * The LED Matrix panel has 32x16 pixels. Several panel can be combined together as a large screen.
 *
 * Coordinate & Connection (Arduino -> panel 0 -> panel 1 -> ...)
 *   (0, 0)                                     (0, 0)
 *     +--------+--------+--------+               +--------+--------+
 *     |   5    |    4   |    3   |               |    1   |    0   |
 *     |        |        |        |               |        |        |<----- Arduino
 *     +--------+--------+--------+               +--------+--------+
 *     |   2    |    1   |    0   |                              (64, 16)
 *     |        |        |        |<----- Arduino
 *     +--------+--------+--------+
 *                             (96, 32)
 *
 */

#include "LEDMatrix.h"

#define WIDTH   32
#define HEIGHT  16

// LEDMatrix(a, b, c, d, oe, r1, stb, clk, b1);
//LEDMatrix matrix(4, 5, 6, 7, 8, 9, 10, 11);
LEDMatrix matrix(2, 3, 4, 5, 6, 11, 10, 13, 9);

// Display Buffer 128 = 64 * 16 / 8
uint8_t displaybuf[WIDTH *HEIGHT / 8] = {
    0x80, 0x00, 0x00, 0x01, 0x00, 0x00, 0x00, 0x00, 0x00, 0x00, 0x00, 0x00, 0x00, 0x00, 0x00, 0x00,
    0x00, 0x00, 0x00, 0x00, 0x00, 0x00, 0x00, 0x00, 0x00, 0x00, 0x00, 0x00, 0x00, 0x00, 0x00, 0x00,
    0x00, 0x00, 0x00, 0x00, 0x00, 0x00, 0x00, 0x00, 0x00, 0x00, 0x00, 0x00, 0x00, 0x00, 0x00, 0x00,
    0x00, 0x00, 0x00, 0x00, 0x00, 0x00, 0x00, 0x00, 0x00, 0x00, 0x00, 0x00, 0x00, 0x00, 0x00, 0x00
};

//16 heights 0 - 8
const uint8_t even_bars[] = {
    0xF0, 0xF0, 0xF0, 0xF0, 0xF0, 0xF0, 0xF0, 0xF0, 0xF0, 0xF0, 0xF0, 0xF0, 0xF0, 0xF0, 0xF0, 0xF0,
    0x00, 0xF0, 0xF0, 0xF0, 0xF0, 0xF0, 0xF0, 0xF0, 0xF0, 0xF0, 0xF0, 0xF0, 0xF0, 0xF0, 0xF0, 0xF0,
    0x00, 0x00, 0xF0, 0xF0, 0xF0, 0xF0, 0xF0, 0xF0, 0xF0, 0xF0, 0xF0, 0xF0, 0xF0, 0xF0, 0xF0, 0xF0,
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    0x00, 0x00, 0x00, 0x00, 0x00, 0x00, 0x00, 0x00, 0x00, 0x00, 0x00, 0x00, 0x00, 0x00, 0x00, 0x00,
};

const uint8_t odd_bars[] = {
  0x0F, 0x0F, 0x0F, 0x0F, 0x0F, 0x0F, 0x0F, 0x0F, 0x0F, 0x0F, 0x0F, 0x0F, 0x0F, 0x0F, 0x0F, 0x0F,
  0x00, 0x0F, 0x0F, 0x0F, 0x0F, 0x0F, 0x0F, 0x0F, 0x0F, 0x0F, 0x0F, 0x0F, 0x0F, 0x0F, 0x0F, 0x0F,
  0x00, 0x00, 0x0F, 0x0F, 0x0F, 0x0F, 0x0F, 0x0F, 0x0F, 0x0F, 0x0F, 0x0F, 0x0F, 0x0F, 0x0F, 0x0F,
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  0x00, 0x00, 0x00, 0x00, 0x00, 0x00, 0x00, 0x00, 0x00, 0x00, 0x00, 0x00, 0x00, 0x00, 0x00, 0x00,
};


void drawRectangle(uint8_t channel, uint8_t height){
    if ((channel > 7) || (height > 16)) {
        return;
    }
    /*if (channel == 0){
      matrix.clear();
    }*/
    uint8_t startByte = channel / 2;
    uint8_t *pDst = displaybuf + startByte;
    const uint8_t *pSrc;
    if (channel & 1 == 1){
      pSrc = odd_bars + (16-height) * 16;
      for (uint8_t i = 0; i < 16; i++) {
        *pDst = *pSrc | (*pDst & 0xF0);
        pDst += WIDTH / 8;
        pSrc++;
      }
    }else{
      pSrc = even_bars + (16-height) * 16;
      for (uint8_t i = 0; i < 16; i++) {
        *pDst = *pSrc | (*pDst & 0x0F);
        pDst += WIDTH / 8;
        pSrc++;
      }
    }
    
    
}


void setup()
{
    Serial.begin(9600);
    matrix.begin(displaybuf, WIDTH, HEIGHT);
    matrix.reverse();
}

void loop()
{ 
  if (Serial.available())  {
     int number = Serial.read();  // convert the character '1'-'9' to decimal 1-9
     uint8_t height = number & 31;
     uint8_t channel = (number >> 5) & 7;
     drawRectangle(channel, height);
  }
    
    matrix.scan();

}

